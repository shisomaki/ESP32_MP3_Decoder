## sdkconfig.defaults
```kconfig
# Override defaults here

#
# Serial flasher config
#
CONFIG_ESPTOOLPY_FLASHSIZE_4MB=y

#
# ESP32-specific config
#

CONFIG_ESP32_DEFAULT_CPU_FREQ_240=y
CONFIG_ESP32_DEFAULT_CPU_FREQ_MHZ=240

FREERTOS_ASSERT_ON_UNTESTED_FUNCTION=n

#
# Partition Table
#
# CONFIG_PARTITION_TABLE_SINGLE_APP is not set
# CONFIG_PARTITION_TABLE_TWO_OTA is not set
CONFIG_PARTITION_TABLE_CUSTOM=y
CONFIG_PARTITION_TABLE_CUSTOM_FILENAME="partitions.csv"
CONFIG_PARTITION_TABLE_CUSTOM_APP_BIN_OFFSET=0x10000
CONFIG_PARTITION_TABLE_FILENAME="partitions.csv"
CONFIG_APP_OFFSET=0x10000

#
# Wi-Fi
#
CONFIG_ESP32_WIFI_STATIC_RX_BUFFER_NUM=16
CONFIG_ESP32_WIFI_DYNAMIC_RX_BUFFER_NUM=64
CONFIG_ESP32_WIFI_DYNAMIC_TX_BUFFER_NUM=64
CONFIG_ESP32_WIFI_AMPDU_TX_ENABLED=y
CONFIG_ESP32_WIFI_TX_BA_WIN=32
CONFIG_ESP32_WIFI_AMPDU_RX_ENABLED=y
CONFIG_ESP32_WIFI_RX_BA_WIN=32
CONFIG_ESP32_WIFI_NVS_ENABLED=y
CONFIG_ESP32_WIFI_TASK_PINNED_TO_CORE_0=
CONFIG_ESP32_WIFI_TASK_PINNED_TO_CORE_1=y

#
# LWIP
#
CONFIG_LWIP_IRAM_OPTIMIZATION=y
CONFIG_LWIP_MAX_SOCKETS=1
CONFIG_LWIP_IP_FRAG=y
CONFIG_LWIP_IP_REASSEMBLY=y
CONFIG_TCPIP_RECVMBOX_SIZE=64

#
# TCP
#
CONFIG_LWIP_MAX_ACTIVE_TCP=1
CONFIG_LWIP_MAX_LISTENING_TCP=1
CONFIG_TCP_MAXRTX=12
CONFIG_TCP_SYNMAXRTX=6
CONFIG_TCP_MSS=1360
CONFIG_TCP_MSL=120
CONFIG_TCP_SND_BUF_DEFAULT=3000
CONFIG_TCP_WND_DEFAULT=14000
CONFIG_TCP_RECVMBOX_SIZE=64
CONFIG_TCP_OVERSIZE_MSS=y

#
# tcpip adapter
#
CONFIG_IP_LOST_TIMER_INTERVAL=120

#
# FreeRTOS
#
CONFIG_FREERTOS_HZ=1000
```
